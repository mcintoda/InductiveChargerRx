## firmware/main/Kconfig.projbuild
```kconfig
menu "brim"

config BRIM_BENCH
    bool "Bench build: never deep-sleep, USB console always on"
    default n
    help
        For bring-up on the bench. Wherever brim would deep-sleep it stays awake instead, keeps the USB console
        and logging running, and restarts itself (the equivalent of a wake-up) when water reaches the wake pad,
        it is put on or lifted off the charger, it is tapped, or the sleep timer runs out.
        Uses a lot more battery: never ship it. Build: sdkconfig.bench (see firmware/README.md).

endmenu
```

## squeeze/firmware/main/Kconfig.projbuild
```kconfig
menu "Squeeze pair"

    choice SQZ_ROLE
        prompt "Which unit is this"
        default SQZ_ROLE_PARENT
        help
            Picks this unit's own colour and how hard it squeezes its holder.
            Build one of each: sdkconfig.parent / sdkconfig.child.
        config SQZ_ROLE_PARENT
            bool "Parent's unit"
        config SQZ_ROLE_CHILD
            bool "Child's unit"
    endchoice

    config SQZ_PAIR_SECRET
        string "Pair secret (identical on both units)"
        default "change-me-before-flashing"
        help
            Hashed into every frame. Units with a different secret ignore each other.

    config SQZ_CHANNEL
        int "Wi-Fi channel used for ESP-NOW"
        range 1 13
        default 1

    config SQZ_LONG_RANGE
        bool "Enable Espressif long-range (LR) PHY mode"
        default n
        help
            Both units must match. Try this only if the plain mode drops out across the house.

    config SQZ_SWELL_DEG
        int "Servo travel for a full squeeze (deg of cam, 90 = full 3 mm per plate)"
        range 10 90
        default 90 if SQZ_ROLE_PARENT
        default 65
        help
            How hard this unit squeezes its holder. The child's unit is gentler.

    config SQZ_SERVO_REST_DEG
        int "Servo angle with the plates retracted (cam minor axis on the plates)"
        range 0 90
        default 45

    config SQZ_SERVO_MIN_US
        int "Servo pulse at 0 deg (us)"
        default 500

    config SQZ_SERVO_MAX_US
        int "Servo pulse at 180 deg (us)"
        default 2400

    config SQZ_SERVO_REVERSE
        bool "Reverse servo direction"
        default n

    config SQZ_COLOR_PARENT
        hex "Parent's colour (0xRRGGBB)"
        default 0x0080FF

    config SQZ_COLOR_CHILD
        hex "Child's colour (0xRRGGBB)"
        default 0xFF8000

    config SQZ_SLEEP_PERIOD_MS
        int "Asleep: check for a squeeze or a call this often (ms)"
        range 500 10000
        default 2000

    config SQZ_DEEP_PERIOD_MS
        int "Asleep for longer than SQZ_RECENT_S: listen for a call this often (ms)"
        range 1000 10000
        default 4000
        help
            Squeezes made while the partner wakes are replayed, so a longer period only delays the first one.

    config SQZ_RECENT_S
        int "After a session, keep the fast listen period (SQZ_SLEEP_PERIOD_MS) this long (s)"
        default 600

    config SQZ_DUPLEX
        bool "Detect a squeeze that starts while the partner's is playing (own-plate pressure compensated)"
        default y
        help
            The unit learns how much its own plates raise the pressure in its holder's hand and subtracts it.
            A squeeze on top is sent; the partner plays it as soon as its own squeeze ends. Off: such a
            squeeze is ignored (plain turn-taking).

    config SQZ_SESSION_IDLE_S
        int "Go to sleep after this long with no squeezes (s)"
        default 90

    config SQZ_TRACE
        bool "Log pressure, level and servo angle at 5 Hz (tuning)"
        default n

endmenu
```

## squeeze/firmware/sdkconfig.defaults
```kconfig
CONFIG_IDF_TARGET="esp32c3"
CONFIG_FREERTOS_HZ=1000
CONFIG_ESP_CONSOLE_USB_SERIAL_JTAG=y
CONFIG_ESP_PHY_CALIBRATION_AND_DATA_STORAGE=y
CONFIG_BOOTLOADER_SKIP_VALIDATE_IN_DEEP_SLEEP=y
CONFIG_BOOTLOADER_LOG_LEVEL_WARN=y
CONFIG_ESPTOOLPY_FLASHSIZE_4MB=y
```
